## conf/machine/fsimx8mm-extra.conf
```bitbake
# Extra file for overrding and adding configurations to the named machine conf
# Sytax <old_macine_file>-extra.conf

WKS_FILE = "fus-updater-sdcard.wks.in"
IMAGE_FSTYPES = "wic"
```
